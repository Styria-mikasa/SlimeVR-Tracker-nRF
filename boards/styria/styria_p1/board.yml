## boards/styria/styria_p1/board.yml
```yaml
# Copyright (c) 2024 Nordic Semiconductor ASA
# SPDX-License-Identifier: Apache-2.0

# The 'smspi' board variant is targeted promico stack with the SM-ICM45686-AK09940A
# where ICM is on SPI, AK is on I2C, external clock disabled.

board:
  name: styria_p1
  vendor: styria
  socs:
    - name: nrf52840
      variants:
      - name: 'uf2'
```
